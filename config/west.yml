## config/west.yml
```yaml
manifest:
  remotes:
    - name: zmkfirmware
      url-base: https://github.com/zmkfirmware
    - name: lykos153
      url-base: https://github.com/Lykos153
  projects:
    - name: zephyr
      remote: zmkfirmware
      revision: v3.5.0+zmk-fixes
      import:
        name-blocklist:
          - ci-tools
          - hal_altera
          - hal_cypress
          - hal_infineon
          - hal_microchip
          - hal_nxp
          - hal_openisa
          - hal_silabs
          - hal_xtensa
          - hal_st
          - hal_ti
          - loramac-node
          - mcuboot
          - mcumgr
          - net-tools
          - openthread
          - edtt
          - trusted-firmware-m
          - sof
    - name: zmk
      remote: lykos153
      revision: Ergo_S-1_OE #f51a4423e34dc846e99cec5d070889409a53ae09 # Ergo_S-1_OE 
      import: app/west.yml
  self:
    path: config
```
